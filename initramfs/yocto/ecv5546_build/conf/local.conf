## initramfs/yocto/meta-eys3d/conf/layer.conf
```bitbake
LCONF_VERSION = "7"

BBPATH .= ":${LAYERDIR}"

BBFILES += "${LAYERDIR}/recipes-*/*/*.bb \
            ${LAYERDIR}/recipes-*/*/*.bbappend"

BBFILE_COLLECTIONS += "eys3d"
BBFILE_PATTERN_eys3d = "^${LAYERDIR}/"
BBFILE_PRIORITY_eys3d = "6"

LAYERSERIES_COMPAT_eys3d = "mickledore"
```
